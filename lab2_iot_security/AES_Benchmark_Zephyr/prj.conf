## CMakeLists.txt
```
# SPDX-License-Identifier: Apache-2.0
#
# Lab 2, Part 2: AES speed vs memory benchmark (NUCLEO-WL55JC, Zephyr)
# Pick a variant at build time with EXTRA_CONF_FILE, e.g.
#   west build -b nucleo_wl55jc <this folder> -- -DEXTRA_CONF_FILE=sw_ram.conf

cmake_minimum_required(VERSION 3.20.0)

find_package(Zephyr REQUIRED HINTS $ENV{ZEPHYR_BASE})
project(aes_benchmark)

target_sources(app PRIVATE src/main.c src/aes_sw_psa.c src/aes_hw_stm32.c)
```

## prj.conf
```kconfig
# Settings shared by every variant.
# The AES implementation itself is chosen by ONE overlay file:
#   sw_ram.conf, sw_rom.conf, sw_rom_fewer.conf or hw.conf

CONFIG_PRINTK=y
CONFIG_TIMING_FUNCTIONS=y      # cycle-accurate timer (Cortex-M4 DWT counter)
CONFIG_ENTROPY_GENERATOR=y     # STM32 hardware RNG
CONFIG_MAIN_STACK_SIZE=4096
```

## hw.conf
```kconfig
# Variant D: the STM32WL55 hardware AES peripheral (no software AES linked)
CONFIG_CRYPTO=y
CONFIG_CRYPTO_STM32=y
```

## sw_ram.conf
```kconfig
# Variant A: software AES (PSA Crypto / TF-PSA-Crypto)
# Lookup tables are generated at runtime and live in RAM.
CONFIG_PSA_CRYPTO=y
CONFIG_PSA_WANT_KEY_TYPE_AES=y
CONFIG_PSA_WANT_ALG_ECB_NO_PADDING=y
CONFIG_MBEDTLS_AES_ROM_TABLES=n
```

## sw_rom.conf
```kconfig
# Variant B: software AES, full lookup tables precomputed in flash (ROM)
CONFIG_PSA_CRYPTO=y
CONFIG_PSA_WANT_KEY_TYPE_AES=y
CONFIG_PSA_WANT_ALG_ECB_NO_PADDING=y
CONFIG_MBEDTLS_AES_ROM_TABLES=y
CONFIG_MBEDTLS_AES_FEWER_TABLES=n
```

## sw_rom_fewer.conf
```kconfig
# Variant C: software AES, ONE lookup table in flash instead of four
# (smaller, but more arithmetic per byte)
CONFIG_PSA_CRYPTO=y
CONFIG_PSA_WANT_KEY_TYPE_AES=y
CONFIG_PSA_WANT_ALG_ECB_NO_PADDING=y
CONFIG_MBEDTLS_AES_ROM_TABLES=y
CONFIG_MBEDTLS_AES_FEWER_TABLES=y
```

## src/main.c
```c
/*
 * Lab 2, Part 2: Encryption speed and memory tradeoffs (NUCLEO-WL55JC)
 *
 * Measures one AES-128 variant per build:
 *   - correctness against the FIPS-197 test vector
 *   - key setup time (first call "cold", then averaged "warm")
 *   - encrypt / decrypt time for one full LoRa payload, and per byte
 *
 * The variant is picked by the overlay passed with -DEXTRA_CONF_FILE=...
 */
#include <string.h>
#include <zephyr/kernel.h>
#include <zephyr/sys/printk.h>
#include <zephyr/timing/timing.h>

#include "aes_backend.h"

#if defined(CONFIG_CRYPTO_STM32)
static const struct aes_backend *const aes = &aes_hw_stm32;
#elif defined(CONFIG_PSA_CRYPTO)
static const struct aes_backend *const aes = &aes_sw_psa;
#else
#error "No AES variant selected: build with -DEXTRA_CONF_FILE=sw_ram.conf (or sw_rom, sw_rom_fewer, hw)"
#endif

/* Largest encrypted payload in one LoRa packet:
 * 255 B max packet - 64 B Ed25519 signature = 191 B, rounded down to 16 B blocks */
#define MSG_LEN    176
#define ITERATIONS 200

/* FIPS-197 Appendix C.1 (AES-128) known-answer test */
static const uint8_t kat_key[16] = {
	0x00, 0x01, 0x02, 0x03, 0x04, 0x05, 0x06, 0x07,
	0x08, 0x09, 0x0a, 0x0b, 0x0c, 0x0d, 0x0e, 0x0f};
static const uint8_t kat_pt[16] = {
	0x00, 0x11, 0x22, 0x33, 0x44, 0x55, 0x66, 0x77,
	0x88, 0x99, 0xaa, 0xbb, 0xcc, 0xdd, 0xee, 0xff};
static const uint8_t kat_ct[16] = {
	0x69, 0xc4, 0xe0, 0xd8, 0x6a, 0x7b, 0x04, 0x30,
	0xd8, 0xcd, 0xb7, 0x80, 0x70, 0xb4, 0xc5, 0x5a};

static uint8_t msg[MSG_LEN], pt[MSG_LEN];
static uint8_t ct[MSG_LEN] __maybe_unused; /* used once you write the timing code */

static inline uint64_t cycles_between(timing_t *a, timing_t *b)
{
	return timing_cycles_get(a, b);
}

/* Print a cycle count as "<cycles> cyc  <ns>.<2 digits> ns" divided by div */
static void print_time(const char *label, uint64_t cycles, uint32_t div)
{
	uint64_t ns_x100 = timing_cycles_to_ns(cycles * 100U) / div;

	printk("  %-28s %8llu cyc  %8llu.%02llu ns\n", label, cycles / div,
	       ns_x100 / 100U, ns_x100 % 100U);
}

static int known_answer_test(void)
{
	uint8_t out[16];

	if (aes->enc_setup(kat_key) || aes->encrypt(out, kat_pt, 16)) {
		return -1;
	}
	aes->enc_teardown();
	if (memcmp(out, kat_ct, 16) != 0) {
		return -2;
	}

	if (aes->dec_setup(kat_key) || aes->decrypt(out, kat_ct, 16)) {
		return -3;
	}
	aes->dec_teardown();
	return memcmp(out, kat_pt, 16) ? -4 : 0;
}

int main(void)
{
	timing_t t0, t1;
	uint64_t cold_setup, setup_sum = 0, enc_sum = 0, dec_sum = 0;
	uint8_t key[16];

	for (int i = 0; i < MSG_LEN; i++) {
		msg[i] = (uint8_t)(i * 7 + 3);
	}
	memcpy(key, kat_key, sizeof(key));

	timing_init();
	timing_start();

	printk("\n=== AES-128 benchmark: %s ===\n", aes->name);
	printk("CPU timer: %u MHz, message: %d B, iterations: %d\n",
	       timing_freq_get_mhz(), MSG_LEN, ITERATIONS);

	if (aes->init()) {
		printk("init FAILED\n");
		return 0;
	}

	/* 1. Cold key setup: the very first call (may build tables, wake HW, ...) */
	t0 = timing_counter_get();
	aes->enc_setup(key);
	t1 = timing_counter_get();
	aes->enc_teardown();
	cold_setup = cycles_between(&t0, &t1);

	/* 2. Correctness */
	int kat = known_answer_test();

	printk("FIPS-197 known-answer test: %s\n", kat ? "FAIL" : "PASS");
	if (kat) {
		printk("  (error %d), not timing a broken implementation\n", kat);
		return 0;
	}

	/*
	 * ======================= YOUR TASK =======================
	 * Measure three things for this AES variant and store the TOTAL
	 * cycles over ITERATIONS runs (printing divides by ITERATIONS):
	 *   setup_sum  time to get ready with a key
	 *   enc_sum    time to encrypt msg (176 B)
	 *   dec_sum    time to decrypt it back
	 *
	 * Timing functions (Zephyr <zephyr/timing/timing.h>):
	 *   timing_t timing_counter_get(void);           read the cycle counter now
	 *   uint64_t cycles_between(timing_t *t0, timing_t *t1);  cycles from t0 to t1
	 *
	 * AES functions (aes_backend.h), all return 0 on success:
	 *   int  aes->enc_setup(const uint8_t key[16]);  get ready to encrypt
	 *   int  aes->encrypt(uint8_t *out, const uint8_t *in, size_t len);
	 *   void aes->enc_teardown(void);                done encrypting
	 *   int  aes->dec_setup(const uint8_t key[16]);  get ready to decrypt
	 *   int  aes->decrypt(uint8_t *out, const uint8_t *in, size_t len);
	 *   void aes->dec_teardown(void);                done decrypting
	 * Every setup must be followed by its teardown before the next setup.
	 *
	 * Only the work being measured goes between t0 and t1.
	 * =========================================================
	 */

	/* 1) Key setup time -> setup_sum
	 *    What: time aes->enc_setup(key) on its own, ITERATIONS times.
	 *    How:  loop ITERATIONS times { t0 = counter; enc_setup(key);
	 *          t1 = counter; enc_teardown(); setup_sum += cycles(t0, t1); }
	 *          (teardown comes after t1, so it is not counted)
	 */

	/* 2) Encryption time -> enc_sum
	 *    What: time ITERATIONS calls of aes->encrypt(ct, msg, MSG_LEN)
	 *          with the key already set up.
	 *    How:  enc_setup(key); t0 = counter;
	 *          loop ITERATIONS times { encrypt(ct, msg, MSG_LEN); }
	 *          t1 = counter; enc_teardown(); enc_sum = cycles(t0, t1);
	 */

	/* 3) Decryption time -> dec_sum
	 *    What: same as 2), but decrypt ct back into pt.
	 *    How:  dec_setup(key); t0 = counter;
	 *          loop ITERATIONS times { decrypt(pt, ct, MSG_LEN); }
	 *          t1 = counter; dec_teardown(); dec_sum = cycles(t0, t1);
	 *    The code below checks that pt matches msg.
	 */

	if (setup_sum == 0 || enc_sum == 0 || dec_sum == 0) {
		printk("Timing not written yet: complete YOUR TASK in main.c\n");
		return 0;
	}

	timing_stop();

	printk("Round trip of %d B payload: %s\n", MSG_LEN,
	       memcmp(pt, msg, MSG_LEN) ? "MISMATCH" : "OK");

	printk("Results (average per call):\n");
	print_time("key setup, first call", cold_setup, 1);
	print_time("key setup", setup_sum, ITERATIONS);
	print_time("encrypt 176 B payload", enc_sum, ITERATIONS);
	print_time("decrypt 176 B payload", dec_sum, ITERATIONS);
	print_time("encrypt per byte", enc_sum, ITERATIONS * MSG_LEN);
	print_time("decrypt per byte", dec_sum, ITERATIONS * MSG_LEN);

	/* One line to paste into a spreadsheet */
	printk("CSV,%s,%llu,%llu,%llu,%llu\n", aes->name, cold_setup,
	       setup_sum / ITERATIONS, enc_sum / (ITERATIONS * MSG_LEN),
	       dec_sum / (ITERATIONS * MSG_LEN));
	printk("    (variant, cold setup cyc, setup cyc, enc cyc/B, dec cyc/B)\n");

	return 0;
}
```

## src/aes_backend.h
```c
/* Common interface every AES variant implements, so main.c can time
 * them all the same way. All lengths are multiples of 16 (AES block). */
#ifndef AES_BACKEND_H
#define AES_BACKEND_H

#include <stddef.h>
#include <stdint.h>

#define AES_KEY_LEN   16
#define AES_BLOCK_LEN 16

struct aes_backend {
	const char *name;

	int (*init)(void);

	/* Key setup: everything needed before the first block can be processed */
	int (*enc_setup)(const uint8_t key[AES_KEY_LEN]);
	int (*encrypt)(uint8_t *out, const uint8_t *in, size_t len);
	void (*enc_teardown)(void);

	int (*dec_setup)(const uint8_t key[AES_KEY_LEN]);
	int (*decrypt)(uint8_t *out, const uint8_t *in, size_t len);
	void (*dec_teardown)(void);
};

extern const struct aes_backend aes_sw_psa;
extern const struct aes_backend aes_hw_stm32;

#endif /* AES_BACKEND_H */
```

## src/aes_hw_stm32.c
```c
/* AES-128 on the STM32WL55 hardware AES peripheral, through Zephyr's
 * crypto driver API (driver: crypto_stm32, devicetree node "aes"). */
#include <zephyr/kernel.h>

#if defined(CONFIG_CRYPTO_STM32)

#include <zephyr/device.h>
#include <zephyr/crypto/crypto.h>
#include "aes_backend.h"

static const struct device *const aes_dev = DEVICE_DT_GET(DT_NODELABEL(aes));
static struct cipher_ctx ctx;
static uint8_t key_copy[AES_KEY_LEN]; /* driver keeps a pointer, not a copy */

static int hw_init(void)
{
	return device_is_ready(aes_dev) ? 0 : -ENODEV;
}

/* "Key setup" here = open a driver session (configures the peripheral) */
static int hw_setup(const uint8_t key[AES_KEY_LEN], enum cipher_op dir)
{
	memcpy(key_copy, key, AES_KEY_LEN);
	ctx = (struct cipher_ctx){
		.keylen = AES_KEY_LEN,
		.key.bit_stream = key_copy,
		.flags = CAP_RAW_KEY | CAP_SEPARATE_IO_BUFS | CAP_SYNC_OPS,
	};
	return cipher_begin_session(aes_dev, &ctx, CRYPTO_CIPHER_ALGO_AES,
				    CRYPTO_CIPHER_MODE_ECB, dir);
}

static int hw_enc_setup(const uint8_t key[AES_KEY_LEN])
{
	return hw_setup(key, CRYPTO_CIPHER_OP_ENCRYPT);
}

static int hw_dec_setup(const uint8_t key[AES_KEY_LEN])
{
	return hw_setup(key, CRYPTO_CIPHER_OP_DECRYPT);
}

/* The driver only accepts ONE 16-byte block per ECB call, so loop */
static int hw_process(uint8_t *out, const uint8_t *in, size_t len)
{
	for (size_t i = 0; i < len; i += AES_BLOCK_LEN) {
		struct cipher_pkt pkt = {
			.in_buf = (uint8_t *)(in + i),
			.in_len = AES_BLOCK_LEN,
			.out_buf = out + i,
			.out_buf_max = AES_BLOCK_LEN,
		};
		int ret = cipher_block_op(&ctx, &pkt);

		if (ret) {
			return ret;
		}
	}
	return 0;
}

static void hw_teardown(void)
{
	cipher_free_session(aes_dev, &ctx);
}

const struct aes_backend aes_hw_stm32 = {
	.name = "HW (STM32 AES peripheral)",
	.init = hw_init,
	.enc_setup = hw_enc_setup,
	.encrypt = hw_process,
	.enc_teardown = hw_teardown,
	.dec_setup = hw_dec_setup,
	.decrypt = hw_process,
	.dec_teardown = hw_teardown,
};

#endif /* CONFIG_CRYPTO_STM32 */
```

## src/aes_sw_psa.c
```c
/* Software AES-128 through the PSA Crypto API (Zephyr's TF-PSA-Crypto).
 * Variants A/B/C only differ in where the AES lookup tables live,
 * which is set by Kconfig (sw_ram.conf / sw_rom.conf / sw_rom_fewer.conf). */
#include <zephyr/kernel.h>

#if defined(CONFIG_PSA_CRYPTO)

#include <psa/crypto.h>
#include "aes_backend.h"

static psa_key_id_t key_id;
static psa_cipher_operation_t op;

static int sw_init(void)
{
	return psa_crypto_init() == PSA_SUCCESS ? 0 : -EIO;
}

/* Import the raw key and start a cipher operation. PSA expands the AES key
 * schedule inside *_setup(), so this is the "key setup" cost. */
static int sw_setup(const uint8_t key[AES_KEY_LEN], bool encrypt)
{
	psa_key_attributes_t attr = PSA_KEY_ATTRIBUTES_INIT;
	psa_status_t st;

	psa_set_key_type(&attr, PSA_KEY_TYPE_AES);
	psa_set_key_bits(&attr, 128);
	psa_set_key_algorithm(&attr, PSA_ALG_ECB_NO_PADDING);
	psa_set_key_usage_flags(&attr, PSA_KEY_USAGE_ENCRYPT | PSA_KEY_USAGE_DECRYPT);

	st = psa_import_key(&attr, key, AES_KEY_LEN, &key_id);
	if (st != PSA_SUCCESS) {
		return -EIO;
	}

	op = psa_cipher_operation_init();
	st = encrypt ? psa_cipher_encrypt_setup(&op, key_id, PSA_ALG_ECB_NO_PADDING)
		     : psa_cipher_decrypt_setup(&op, key_id, PSA_ALG_ECB_NO_PADDING);
	return st == PSA_SUCCESS ? 0 : -EIO;
}

static int sw_enc_setup(const uint8_t key[AES_KEY_LEN]) { return sw_setup(key, true); }
static int sw_dec_setup(const uint8_t key[AES_KEY_LEN]) { return sw_setup(key, false); }

/* ECB has no chaining state, so the same operation can process many buffers */
static int sw_process(uint8_t *out, const uint8_t *in, size_t len)
{
	size_t out_len;

	return psa_cipher_update(&op, in, len, out, len, &out_len) == PSA_SUCCESS &&
		       out_len == len ? 0 : -EIO;
}

static void sw_teardown(void)
{
	psa_cipher_abort(&op);
	psa_destroy_key(key_id);
}

const struct aes_backend aes_sw_psa = {
#if defined(CONFIG_MBEDTLS_AES_FEWER_TABLES)
	.name = "SW (PSA), ROM + fewer tables",
#elif defined(CONFIG_MBEDTLS_AES_ROM_TABLES)
	.name = "SW (PSA), ROM tables",
#else
	.name = "SW (PSA), RAM tables",
#endif
	.init = sw_init,
	.enc_setup = sw_enc_setup,
	.encrypt = sw_process,
	.enc_teardown = sw_teardown,
	.dec_setup = sw_dec_setup,
	.decrypt = sw_process,
	.dec_teardown = sw_teardown,
};

#endif /* CONFIG_PSA_CRYPTO */
```
